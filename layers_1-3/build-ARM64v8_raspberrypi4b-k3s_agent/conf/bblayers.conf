## layers_1-3/build-ARM64v8_raspberrypi4b-k3s_agent/conf/bblayers.conf
```bitbake
# POKY_BBLAYERS_CONF_VERSION is increased each time build/conf/bblayers.conf
# changes incompatibly
POKY_BBLAYERS_CONF_VERSION = "2"

BBPATH = "${TOPDIR}"
BBFILES ?= ""

BBLAYERS ?= " \
  /workdir/poky/meta \
  /workdir/poky/meta-poky \
  /workdir/poky/meta-yocto-bsp \
  /workdir/poky/meta-raspberrypi \
  /workdir/poky/meta-openembedded/meta-oe \
  /workdir/poky/meta-openembedded/meta-networking \
  /workdir/poky/meta-openembedded/meta-filesystems \
  /workdir/poky/meta-openembedded/meta-python \
  /workdir/poky/meta-virtualization \
  /workdir/poky/meta-thesis \
  /workdir/poky/meta-k3s \
  /workdir/poky/meta-cni \
"
```

## layers_1-3/build-ARM64v8_raspberrypi4b-k3s_agent/conf/local.conf
```bitbake
MACHINE ??= "raspberrypi4-64"
DISTRO ?= "thesis"

PACKAGE_CLASSES ?= "package_rpm"
EXTRA_IMAGE_FEATURES ?= "debug-tweaks"
USER_CLASSES ?= "buildstats image-mklibs image-prelink"
PATCHRESOLVE = "noop"
BB_DISKMON_DIRS ??= "\
    STOPTASKS,${TMPDIR},1G,100K \
    STOPTASKS,${DL_DIR},1G,100K \
    STOPTASKS,${SSTATE_DIR},1G,100K \
    STOPTASKS,/tmp,100M,100K \
    ABORT,${TMPDIR},100M,1K \
    ABORT,${DL_DIR},100M,1K \
    ABORT,${SSTATE_DIR},100M,1K \
    ABORT,/tmp,10M,1K"
PACKAGECONFIG_append_pn-qemu-system-native = " sdl"

CONF_VERSION = "1"

INSTALL:append = " rpi-config rpi-cmdline"
RPI_USE_U_BOOT = "1"
ENABLE_UART = "1"
CMDLINE:append = " cgroup_memory=1 cgroup_enable=memory"

K3S_SERVER_URI = "s-b9679a59db"
K3S_SERVER_TOKEN = "K100583f2734d02ba2ebd9e5ee0475b4d2f00210d2e44db5b804aebfec1d0bc6297::server:fc8f87330c25451626f05d24c2a0dbb4"

IMAGE_INSTALL:append = " k3s-agent weave"
```

## layers_1-3/build-ARM64v8_raspberrypi4b-k3s_server/conf/local.conf
```bitbake
MACHINE ??= "raspberrypi4-64"
DISTRO ?= "thesis"

PACKAGE_CLASSES ?= "package_rpm"
EXTRA_IMAGE_FEATURES ?= "debug-tweaks"
USER_CLASSES ?= "buildstats image-mklibs image-prelink"
PATCHRESOLVE = "noop"
BB_DISKMON_DIRS ??= "\
    STOPTASKS,${TMPDIR},1G,100K \
    STOPTASKS,${DL_DIR},1G,100K \
    STOPTASKS,${SSTATE_DIR},1G,100K \
    STOPTASKS,/tmp,100M,100K \
    ABORT,${TMPDIR},100M,1K \
    ABORT,${DL_DIR},100M,1K \
    ABORT,${SSTATE_DIR},100M,1K \
    ABORT,/tmp,10M,1K"
PACKAGECONFIG_append_pn-qemu-system-native = " sdl"

CONF_VERSION = "1"

INSTALL:append = " rpi-config rpi-cmdline"
RPI_USE_U_BOOT = "1"
ENABLE_UART = "1"
CMDLINE:append = " cgroup_memory=1 cgroup_enable=memory"

IMAGE_INSTALL:append = " k3s-server weave"
```

## layers_1-3/meta-cni/conf/layer.conf
```bitbake
# We have a conf and classes directory, add to BBPATH
BBPATH .= ":${LAYERDIR}"

# We have recipes-* directories, add to BBFILES
BBFILES += "${LAYERDIR}/recipes-*/*/*.bb \
            ${LAYERDIR}/recipes-*/*/*.bbappend"

BBFILE_COLLECTIONS += "meta-cni"
BBFILE_PATTERN_meta-cni = "^${LAYERDIR}/"
BBFILE_PRIORITY_meta-cni = "5"

LAYERDEPENDS_meta-cni = " \
    core \
    meta-k3s \
"

LAYERSERIES_COMPAT_meta-cni = "dunfell"
```

## layers_1-3/meta-k3s/conf/layer.conf
```bitbake
# We have a conf and classes directory, add to BBPATH
BBPATH .= ":${LAYERDIR}"

# We have recipes-* directories, add to BBFILES
BBFILES += "${LAYERDIR}/recipes-*/*/*.bb \
            ${LAYERDIR}/recipes-*/*/*.bbappend"

BBFILE_COLLECTIONS += "meta-k3s"
BBFILE_PATTERN_meta-k3s = "^${LAYERDIR}/"
BBFILE_PRIORITY_meta-k3s = "6"

LAYERDEPENDS_meta-k3s = " \
    core \
    virtualization-layer \
"

LAYERSERIES_COMPAT_meta-k3s = "dunfell"
```

## layers_1-3/meta-thesis/conf/distro/include/image_dependencies.inc
```bitbake
IMAGE_ROOTFS_EXTRA_SPACE = "10000000"

IMAGE_INSTALL:append = " iproute2 iptables ebtables ca-certificates"
IMAGE_INSTALL:append = " libnetfilter-conntrack conntrack-tools ethtool"
IMAGE_INSTALL:append = " ntp curl"
IMAGE_INSTALL:append = " kubernetes"

IMAGE_FEATURES:append = " ssh-server-dropbear"

IMAGE_FEATURES_remove = " psplash"

NOHDD="1"
NOISO="1"
```

## layers_1-3/meta-thesis/conf/distro/include/kernel_dependencies.inc
```bitbake
KERNEL_MODULE_AUTOLOAD += " \
    br_netfilter \
    "

IMAGE_INSTALL:append = " \
    kernel-module-xt-addrtype \
    kernel-module-xt-nat \
    kernel-module-xt-multiport \
    kernel-module-xt-conntrack \
    kernel-module-xt-comment \
    kernel-module-xt-mark \
    kernel-module-xt-connmark \
    kernel-module-vxlan \
    kernel-module-xt-masquerade \
"
```

## layers_1-3/meta-thesis/conf/distro/thesis.conf
```bitbake
DISTRO = "thesis"
DISTRO_NAME = "Master Thesis PoC distribution"
DISTRO_VERSION = "1.0.0"
DISTRO_CODENAME = "dunfell"

MAINTAINER = "Max van Deurzen"

TARGET_VENDOR = "-poky"

LOCALCONF_VERSION = "1"

DISTRO_VERSION[vardepsexclude] = "DATE"
SDK_VERSION[vardepsexclude] = "DATE"

# Override these in poky based distros
POKY_DEFAULT_DISTRO_FEATURES = "largefile multiarch"
POKY_DEFAULT_EXTRA_RDEPENDS = "packagegroup-core-boot"
POKY_DEFAULT_EXTRA_RRECOMMENDS = "kernel-module-af-packet"

DISTRO_FEATURES ?= "${DISTRO_FEATURES_DEFAULT} ${POKY_DEFAULT_DISTRO_FEATURES}"

DISTRO_FEATURES:append = " systemd"
DISTRO_FEATURES_BACKFILL_CONSIDERED = "sysvinit"
VIRTUAL-RUNTIME_init_manager = "systemd"
VIRTUAL-RUNTIME_initscripts = "systemd-compat-units"

DISTRO_FEATURES:append = " virtualization k8s"

PREFERRED_VERSION_linux-yocto ?= "5.4%"

SDK_NAME = "${DISTRO}-${TCLIBC}-${SDKMACHINE}-${IMAGE_BASENAME}-${TUNE_PKGARCH}-${MACHINE}"
SDKPATHINSTALL = "/opt/${DISTRO}/${SDK_VERSION}"

DISTRO_EXTRA_RDEPENDS += " ${POKY_DEFAULT_EXTRA_RDEPENDS}"
DISTRO_EXTRA_RRECOMMENDS += " ${POKY_DEFAULT_EXTRA_RRECOMMENDS}"

TCLIBCAPPEND = ""

PREMIRRORS ??= "\
bzr://.*/.*   http://downloads.yoctoproject.org/mirror/sources/ \n \
cvs://.*/.*   http://downloads.yoctoproject.org/mirror/sources/ \n \
git://.*/.*   http://downloads.yoctoproject.org/mirror/sources/ \n \
gitsm://.*/.* http://downloads.yoctoproject.org/mirror/sources/ \n \
hg://.*/.*    http://downloads.yoctoproject.org/mirror/sources/ \n \
osc://.*/.*   http://downloads.yoctoproject.org/mirror/sources/ \n \
p4://.*/.*    http://downloads.yoctoproject.org/mirror/sources/ \n \
svn://.*/.*   http://downloads.yoctoproject.org/mirror/sources/ \n"

SANITY_TESTED_DISTROS ?= " \
            ubuntu-18.04 \n \
            5.15.26-gentoo-x86_64 \n \
            "

# add poky sanity bbclass
INHERIT += "poky-sanity"

# QA check settings - a little stricter than the OE-Core defaults
WARN_TO_ERROR_QA = "already-stripped compile-host-path install-host-path \
                    installed-vs-shipped ldflags pn-overrides rpaths staticdev \
                    unknown-configure-option useless-rpaths"
WARN_QA_remove = "${WARN_TO_ERROR_QA}"
ERROR_QA_append = " ${WARN_TO_ERROR_QA}"

require conf/distro/include/poky-world-exclude.inc
require conf/distro/include/no-static-libs.inc
require conf/distro/include/yocto-uninative.inc
require conf/distro/include/security_flags.inc

require conf/distro/include/image_dependencies.inc
require conf/distro/include/kernel_dependencies.inc

INHERIT += "uninative"

INHERIT += "reproducible_build"

BB_SIGNATURE_HANDLER ?= "OEEquivHash"
BB_HASHSERVE ??= "auto"

HOST_NAME ??= "thesis"
hostname_pn-base-files ??= "${HOST_NAME}"
```

## layers_1-3/meta-thesis/conf/layer.conf
```bitbake
# We have a conf and classes directory, add to BBPATH
BBPATH .= ":${LAYERDIR}"

# We have recipes-* directories, add to BBFILES
BBFILES += "${LAYERDIR}/recipes-*/*/*.bb \
            ${LAYERDIR}/recipes-*/*/*.bbappend"

BBFILE_COLLECTIONS += "meta-thesis"
BBFILE_PATTERN_meta-thesis = "^${LAYERDIR}/"
BBFILE_PRIORITY_meta-thesis = "6"

LAYERDEPENDS_meta-thesis = "core"
LAYERSERIES_COMPAT_meta-thesis = "dunfell"
```
